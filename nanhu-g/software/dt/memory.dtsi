/{
#if defined(FPGA_NM37) || defined(FPGA_NP19A) || defined(FPGA_U280) || defined(FPGA_MIMIC_TURBO) || defined(FPGA_VCU1525)
	
	mem: memory@80000000 {
		device_type = "memory";
		reg = <0x0 0x80000000 0x3 0x80000000>;
	};
	
#elif defined(FPGA_VCU128)
	
	mem: memory@80000000 {
		device_type = "memory";
		reg = <0x0 0x80000000 0x4 0x00000000 0x00000000 0x80000000>;
	};
	
#endif
};
